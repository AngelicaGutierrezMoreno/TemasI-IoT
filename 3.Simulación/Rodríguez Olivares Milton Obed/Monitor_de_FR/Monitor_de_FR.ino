//**MONITOR DE FRECUENCIA RESPIRATORIA**
//**TEMAS SELECTOS DE ELECTRÓNICA Y COMPUTACIÓN**
//**INTERNET DE LAS COSAS**
//**FACULTAD DE INSTRUMETNTACIÓN EÑLECTRÓNICA
//**UNIVERSIDAD VERACRUZANA
//´**AUTORES:
//**CASTILLO VASQUEZ JORGE MIGUEL
//**COLORADO MARTÍNEZ JESSÚS ALEJADNRO
//**GUTIÉRREZ MORENO ANGÉLICA
//**CATEDRATICO:
//**SERGIO FRANCISCO HERNÁNDEZ MACHUCA

//Librerías a incluir
#include <WiFi.h>                 //Librería para conectar a WiFi
#include <PubSubClient.h>         //Librería para el cliente, con esto es posible conectarse a la red
#include "DHTesp.h"               //Librería para el sensor DHT11

//Definición de variables
#define DHTpin 4                  //Pin para el sensor DHT11 (GPIO 4)
#define WIFISSID "JOMI"           //Nombre de la red WiFi que se conectará la ESP32
#define PASSWORD "12345678"       //Contraseña de la red WiFi
//cuenta 1
#define TOKEN "BBFF-q94t6MVy5ze2cPyHPk0kE158UVAyX2" //TOKEN del servidor Ubidots
//cuenta 2
//#define TOKEN "BBFF-sJLNHu2aw6kATFvlxwCMN8MDDiIybs" //TOKEN del servidor Ubidots

#define MQTT_CLIENT_NAME "JorgeMigu" //Nombre del cliente MQTT,se debe introducir un una conmbinación alfanumérica de 8 a 12 caracteres
// Etiqueta de las variables que se destinarán al servidor
#define VARIABLE_LABEL "respiracion" //Variable de la frecuencia respiratoria
#define VARIABLE_LABEL_SUBSCRIBE "contador" //Variable del contador de repiraciones por minuto
#define VARIABLE_LABEL_SUBSCRIBE2 "temperatura" //Variable de la temperatura corporal
#define VARIABLE_LABEL_SUBSCRIBE3 "temperaturaambiente" //Variable de la temperatura ambiente
#define DEVICE_LABEL "esp32s" // Etiqueta del dispositivo

const int sensor = 34;            //Pin asignado al sensor MQ135

byte data[128] ;                  // Para guardar las lecturas del sensor MQ135
byte indexs = 0 ;
byte anterior;

int ThermistorPin = 35;           //Pin asignado al termistor 


//Valores para la configuración del termistor
double R1 = 10000.0;              // Valor de la resistencia que se pondrá en serie con el termistor
double Beta = 3950.0;             // Valor de beta (ver datasheet)
double To = 298.15;               // Temperatura en Kelvin a 25°C
double Ro = 10000.0;              // Resistencia del termistor a 25°C (ver datasheet)
//LUT PARA EL ADC, ya que el comportamiento del ADC de la placa ESP32 no es lineal se crea esta matriz para volverlo lineal
//Más información en: https://github.com/e-tinkers/esp32-adc-calibrate
const float ADC_LUT[4096] PROGMEM  = { 0,
33.0000,34.8000,36.4000,38.0000,39.8000,41.6000,43.0000,44.8000,46.8000,48.0000,49.6000,50.8000,52.0000,53.2000,54.6000,
55.8000,57.0000,58.2000,59.6000,60.8000,62.0000,63.2000,64.6000,65.4000,66.4000,67.2000,68.2000,69.2000,70.0000,71.0000,
72.0000,73.0000,74.0000,75.0000,76.0000,77.0000,77.8000,78.8000,79.8000,81.0000,82.0000,83.4000,84.8000,86.0000,87.0000,
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4007.0000,4007.8000,4008.6001,4009.0000,4009.8000,4010.2000,4011.0000,4011.8000,4012.0000,4012.8000,4013.3999,4014.0000,4014.8000,4015.2000,4016.00
};


long rango = 5;                     //Este es el rango por el que se disparará la salida 2 y pasa a estado lógico 1
long ultimamedicion;                //Contiene el valor de la última medición que disparó a lógico 1, la salida 2
int ciclo = 0;                      //1=alto 0=bajo
int cambiodeciclo = 0;
int picodetension;
int valledetension = 1023;
long contadorciclo;
boolean estadoBPM = true;           //guarda el estado del led (encendido o apagado)
boolean estadoLed = true;           //guarda el estado del led (encendido o apagado)
int intervaloEncendido = 1;         // tiempo que esta encendido el led
int IntervaloApagado = 1;           // tiempo que esta apagado el led
  
int IntervaloBPM = 10000;           // tiempo que esta apagado el led
int IntervaloBPM2 = 1;              // tiempo que esta apagado el led
int contador = 0;
unsigned long tiempoAnteriorEncendido = 0;    //guarda tiempo de referencia para comparar
unsigned long tiempoAnteriorApagado = 0;      //guarda tiempo de referencia para comparar
unsigned long tiempoAnteriorBPM = 0;          //guarda tiempo de referencia para comparar
unsigned long tiempoAnteriorBPM2 = 0;         //guarda tiempo de referencia para comparar
int lecturaSensor=0;
int pulsos = 0;
int pulsos2 = 0;
int senal = 0;
int contador1=1;

char mqttBroker[]  = "things.ubidots.com";    //Servidor
char payload[100];
char topic[150];
char topicSubscribe[100];
// cadenas que se manda´ran al servidor
char str_lecturaSensor[10];
char str_contador1[10];
char str_temperatura[10];
char str_temperature[10];

double Vout, Rt = 0;
double T, Tc, Tf = 0;
double adc1 = 0;
double humidity = 0.0;
double temperature = 0.0;

DHTesp dht;
WiFiClient ubidots;
PubSubClient client(ubidots);

//Ciclo para la reconección del servidor
void reconnect() {
  // Ciclo infinito hasta que se reconecte al servidor
  while (!client.connected()) {
    Serial.println("Intentando conección MQTT...");
    // Intentando conectar
    if (client.connect(MQTT_CLIENT_NAME, TOKEN, "")) {
        Serial.println("Conectado");
        client.subscribe(topicSubscribe);
    } 
    else {
        Serial.print("Failed, rc=");
        Serial.print(client.state());
        Serial.println(" try again in 2 seconds");
        //Espera dos segundos antes de reintentar
        delay(2000);
    }
  }
}
//Ciclo para cargar las cadenas al servidor
void callback(char* topic, byte* payload, unsigned int length) {
  char p[length + 1];
  memcpy(p, payload, length);
  p[length] = NULL;
  String message(p);
  Serial.write(payload, length);
  Serial.println();
}


void setup() {
  Serial.begin(115200);                 //Velocidad en baudios del puerto serial
  WiFi.begin(WIFISSID, PASSWORD);       //Conección a la red Wifi
  pinMode(2, OUTPUT);                   //Pin GPIO2 como salida
  dht.setup(DHTpin, DHTesp::DHT11);     //Configuramos el sensor DHT que vamos a utilizar
  Serial.println();
  Serial.print("Esperando red Wifi...");
  while (WiFi.status() != WL_CONNECTED) //Mientras no esté conectado pondrá un punto cada medio segundo simulando estar esperando
  {
    Serial.print(".");
    delay(500);
  }
  
  Serial.println("");
  Serial.println("WiFi Conectado");     //Mensaje de que el wifi está conectado
  Serial.println("Dirección IP: ");
  Serial.println(WiFi.localIP());
  client.setServer(mqttBroker, 1883);
  client.setCallback(callback);
  sprintf(topicSubscribe, "/v1.6/devices/%s/%s/lv", DEVICE_LABEL, VARIABLE_LABEL_SUBSCRIBE, VARIABLE_LABEL_SUBSCRIBE2, VARIABLE_LABEL_SUBSCRIBE3);
  client.subscribe(topicSubscribe);
}


void loop() {       
  for (int im =0 ; im<16 ; im++)                          //Loop para contar las repiraciones por minuto
     {
            //Obteniendo en valor de la temperatura corporal 
            adc1 = analogRead(ThermistorPin);
            adc1 = ADC_LUT[(int)adc1];
            Vout = adc1 * (3.3/4095);
            Rt = R1 * Vout / (3.3 - Vout);
            T = 1/(1/To + log(Rt/Ro)/Beta);               // Temperatura in Kelvin
            Tc = T - 273.15;                              // Celsius
            Serial.print("Temperatura Corporal: ");
            Serial.print(Tc); 
            Serial.println("°C"); 

            //Obteniendo el valor del sensor MQ135
            lecturaSensor=analogRead(sensor);
            lecturaSensor = ADC_LUT[(int)lecturaSensor];
            lecturaSensor=lecturaSensor*7;
            Serial.println(lecturaSensor);

            //Momento de subir nuestras variables al servidor
            if (!client.connected())                      //Si no está conectado intentarpá reconectar   
            {
              client.subscribe(topicSubscribe);   
              reconnect();
            }
            
            sprintf(topic, "%s%s", "/v1.6/devices/", DEVICE_LABEL);     //Conecta a nuestro dispositivo
            
            sprintf(payload, "%s", "");                                 //Limpia el payload 
            sprintf(payload, "{\"%s\":", VARIABLE_LABEL);               //Agrega variable label
            dtostrf(lecturaSensor, 4, 2, str_lecturaSensor);            //Cargamos nuestro valor del sensor a una cadena            
            sprintf(payload, "%s {\"value\": %s}}", payload, str_lecturaSensor); // Agregamos el valor al payload
            client.publish(topic, payload);                             //Publicamos el valor al servidor

            sprintf(payload, "%s", "");                                 //Limpia el payload 
            sprintf(payload, "{\"%s\":", VARIABLE_LABEL_SUBSCRIBE);     //Agrega variable label subscribe
            dtostrf(contador1, 4, 2, str_contador1);                    //Cargamos nuestro valor del contador a una cadena
            sprintf(payload, "%s {\"value\": %s}}", payload, str_contador1); // Agregamos el valor al payload
            client.publish(topic, payload);                             //Publicamos el valor al servidor

                      
            sprintf(payload, "%s", "");                                 //Limpia el payload 
            sprintf(payload, "{\"%s\":", VARIABLE_LABEL_SUBSCRIBE2);    //Agrega variable label subscribe2
            dtostrf(Tc, 4, 2, str_temperatura);                         //Cargamos nuestro valor de la temperatura corporal a una cadena
            sprintf(payload, "%s {\"value\": %s}}", payload, str_temperatura); // Agregamos el valor al payload
            client.publish(topic, payload);

            sprintf(payload, "%s", "");                                 //Limpia el payload 
            sprintf(payload, "{\"%s\":", VARIABLE_LABEL_SUBSCRIBE3);    //Agrega variable label subscribe3
            dtostrf(temperature, 4, 2, str_temperature);                //Cargamos nuestro valor de la temperatura ambiente a una cadena
            sprintf(payload, "%s {\"value\": %s}}", payload, str_temperature); // Agregamos el valor al payload
            client.publish(topic, payload);                             //Publicamos el valor al servidor   
            
            Serial.println("Datos publicados a la nube Ubidots");
            client.loop();

            //Procesamiento de las repiraciones por minuto
            data[indexs] = 64 * lecturaSensor/1024;
            indexs++; 
            byte i = indexs ;
          
            senal=lecturaSensor;                                        //guardamos el valor en la variable senal
            
            if (senal >= ( ultimamedicion+120) )                        // La salida 2 pasa a 1 logico si la tensión medida en la entrada analógica 0 es mayor que la anterior lectura + latensión de RANGO
             {
                ultimamedicion = senal;                                 // SE ASIGANA A LA VARIABLE ULTIMAMEDICION EL VALOR LEIDO POR LA ENTRADA ANALÓGICA CERO 
                ciclo=1;
                if (senal>picodetension)                                // SI LA TENSIÓN MEDIDA POR LA ENTRADA CERO, ES LA MAYOR DETECTADA, SE ASIGNA A LA VARIABLE PICODETENSIÓN EL VALOR LEIDO POR AL ENTRADA CERO ANALÓGICA 
                {
                picodetension=senal;                                    // SE ASIGNA EL VALOR LEIDO POR LA ENTRADA CERO ANALÓGICA A LA VARIABLE PICODETENSIÓN.
                }
             }
               
            if (senal <= ( ultimamedicion-120))                         // La salida 2 pasa a 1 lógico si la tensión medida en la entrada analógica 0 es menor que la anterior lectura - la tensión de RANGO
             {
               ultimamedicion = senal;                                  // SE ASIGNA A LA VARIABLE ULTIMAMEDICIÓN LA LECTURA MEDIDA POR EL PUERTO ANALÓGICO CERO
               ciclo=0;                                                 // EL CICLO SE PONE A CERO, ES DECIR, QUE EL VOLTAJE EMPIEZA A BAJAR DESDE EL PICO DE TENSIÓN MÁS ALTA
               if (senal<valledetension)                                // SE CUMPLE LA CONDICIÓN SI LA TENSIÓN DETECTADA POR EL PUERTO ANALÓGICO CERO ES MENOR QUE LA CONTENIDA EN LA VARIABLE VALLEDETENSIÓN
               {
                  valledetension=senal;                                 //Se asigna a la variable valledetensión el valor medido por la entrada analógica cero
               }
             }
          
            if(millis()-tiempoAnteriorBPM>=IntervaloBPM)                 //si ha transcurrido el periodo programado
            {                                                  
              lecturaSensor=analogRead(sensor);
              estadoBPM=false;
              pulsos2=pulsos;
              tiempoAnteriorBPM=millis();                               //guarda el tiempo actual para comenzar a contar el tiempo apagad
              pulsos=0;   
            }
              
            if(millis()-tiempoAnteriorBPM2>=IntervaloBPM2)              //si ha transcurrido el periodo programado
            {       
                lecturaSensor=analogRead(sensor);
                estadoBPM=true;
                // pulsos2=(pulsos2+pulsos2)/2;
                //Serial.print(pulsos2*4);
              tiempoAnteriorBPM2=millis();  //guarda el tiempo actual para comenzar a contar el tiempo apagado
            }
            if((millis()-tiempoAnteriorEncendido>=intervaloEncendido)&&estadoLed==true && ciclo==0) //si ha transcurrido el periodo programado
            {  
              estadoLed=false;                                          //actualizo la variable para apagar el led
              picodetension=senal;                                      //SE ASIGNA A LA VARIABLE PICODETENSIÓN EL VALOR DE LA TENSIÒN LEIDA POR EL PUERTO ANALÓGICO CERO
              valledetension=senal;                                     //SE ASIGNA A LA VALLEDETENSION EL VALOR DE LA TENSIÒN LEIDA POR EL PUERTO ANALÓGICO CERO  
              digitalWrite(2,HIGH);                                     //apago el led
              contador = contador +1;
              //Serial.println("Eex");
              tiempoAnteriorApagado=millis();                           //guarda el tiempo actual para comenzar a contar el tiempo apagado
            }
            
            if((millis()-tiempoAnteriorApagado>=IntervaloApagado)&&estadoLed==false && ciclo==1) //si ha transcurrido el periodo programado
            {  
              pulsos++;
              picodetension=senal;                                       //SE ASIGNA A LA VARIABLE PICODETENSIÓN EL VALOR DE LA TENSIÒN LEIDA POR EL PUERTO ANALÓGICO CERO
              valledetension=senal;                                      //SE ASIGNA A LA VALLEDETENSION EL VALOR DE LA TENSIÒN LEIDA POR EL PUERTO ANALÓGICO CERO
              estadoLed=true;                                            //actualizo la variable para encender el led 
              digitalWrite(2,LOW);                                       //enciendo el led
              tiempoAnteriorEncendido=millis();                          //guarda el tiempo actual para comenzar a contar el tiempo encendido
            }
       delay(1000);
       }
    Serial.println("Respiraciones por minuto: "); 
    contador1 = contador*4;
    Serial.println(contador1); 
    contador=0;

    //Obtención  de la temperatura ambiente
    delay(dht.getMinimumSamplingPeriod());
    humidity = dht.getHumidity();
    temperature = dht.getTemperature();
    Serial.print("Temperatura Ambiente: ");
    Serial.print(temperature, 1);
    Serial.println("°C");
}
